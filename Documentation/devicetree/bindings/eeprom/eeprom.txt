## Documentation/devicetree/bindings/eeprom/eeprom.txt
```
= EEPROM Data Device Tree Bindings =

This binding is intended to represent the location of hardware
configuration data stored in EEPROMs.

On a significant proportion of boards, the manufacturer has stored
some data on an EEPROM-like device, for the OS to be able to retrieve
these informations and act upon it. Obviously, the OS has to know
about where to retrieve these data from, and where they are stored on
the storage device.

This document is here to document this.

= Data providers =

Required properties:
#eeprom-cells:	Number of cells in an eeprom specifier; The common
		case is 2.

For example:

	at24: eeprom@42 {
		#eeprom-cells = <2>;
	};

= Data consumers =

Required properties:

eeproms: List of phandle and data cell specifier triplet, one triplet
	 for each data cell the device might be interested in. The
	 triplet consists of the phandle to the eeprom provider, then
	 the offset in byte within that storage device, and the length
	 in byte of the data we care about.

Optional properties:

eeprom-names: List of data cell name strings sorted in the same order
 	      as the resets property. Consumers drivers will use
 	      eeprom-names to differentiate between multiple cells,
 	      and hence being able to know what these cells are for.

For example:

	device {
		eeproms = <&at24 14 42>;
		eeprom-names = "soc-rev-id";
	};
```

## Documentation/devicetree/bindings/mfd/axp20x.txt
```
AXP202/AXP209 device tree bindings

The axp20x family current members :-
axp202 (X-Powers)
axp209 (X-Powers)

Required properties:
- compatible: "x-powers,axp202" or "x-powers,axp209"
- reg: The I2C slave address for the AXP chip
- interrupt-parent: The parent interrupt controller
- interrupts: Interrupt specifiers for interrupt sources
- interrupt-controller: axp20x has its own internal IRQs
- #interrupt-cells: Should be set to 1

- regulators: A node that houses a sub-node for each regulator. The regulators are
	      bound using their name as listed here: dcdc2, dcdc3, ldo1, ldo2,
	      ldo3, ldo4, ldo5.  The bindings details of individual regulator
	      device can be found in:
	      Documentation/devicetree/bindings/regulator/regulator.txt with
	      the exception of x-powers,dcdc-freq
	      Parent regulators must be set in the vin-supply property

- x-powers,dcdc-freq: defines the work frequency of DC-DC in KHz
		      (range: 750-1875). Default: 1.5MHz

Optional properties for DCDCs:
- x-powers,dcdc-workmode: 1 for PWM mode, 0 for AUTO mode
			  Default: AUTO mode

Example:

axp209: pmic@34 {
	compatible = "x-powers,axp209";
	reg = <0x34>;
	interrupt-parent = <&nmi_intc>;
	interrupts = <0 8>;

	interrupt-controller;
	#interrupt-cells = <1>;

	regulators {
		x-powers,dcdc-freq = <1500>;

		axp_vcore_reg: dcdc2 {
			vin-supply = <&axp_ipsout_reg>;
			regulator-min-microvolt = <700000>;
			regulator-max-microvolt = <2275000>;
			regulator-always-on;
		};

		axp_ddr_reg: dcdc3 {
			vin-supply = <&axp_ipsout_reg>;
			regulator-min-microvolt = <700000>;
			regulator-max-microvolt = <3500000>;
			regulator-always-on;
		};

		axp_rtc_reg: ldo1 {
			vin-supply = <&axp_ipsout_reg>;
			regulator-always-on;
		};

		axp_analog_reg: ldo2 {
			vin-supply = <&axp_ipsout_reg>;
			regulator-min-microvolt = <1800000>;
			regulator-max-microvolt = <3300000>;
			regulator-always-on;
		};

		axp_pll_reg: ldo3 {
			vin-supply = <&axp_ipsout_reg>;
			regulator-min-microvolt = <700000>;
			regulator-max-microvolt = <3500000>;
		};

		axp_hdmi_reg: ldo4 {
			vin-supply = <&axp_ipsout_reg>;
			regulator-min-microvolt = <1250000>;
			regulator-max-microvolt = <3300000>;
		};

		axp_mic_reg: ldo5 {
			vin-supply = <&axp_ipsout_reg>;
			regulator-min-microvolt = <1800000>;
			regulator-max-microvolt = <3300000>;
		};
	};
};
```

## drivers/eeprom/Kconfig
```kconfig
menuconfig EEPROM
	bool "EEPROM Support"
	help
	  Support for EEPROM alike devices.

	  This framework is designed to provide a generic interface to EEPROM
	  from both the Linux Kernel and the userspace.

	  If unsure, say no.

if EEPROM

config EEPROM_DEBUG
	bool "EEPROM debug support"
	help
	  Say yes here to enable debugging support.

config EEPROM_AT25
	tristate "SPI EEPROMs from most vendors"
	depends on SPI
	help
	  Enable this driver to get read/write support to most SPI EEPROMs,
	  after you configure the board init code to know about each eeprom
	  on your target board.

	  This driver can also be built as a module.  If so, the module
	  will be called at25.

config EEPROM_SUNXI_SID
	depends on ARCH_SUNXI
	tristate "Allwinner SoCs SID support"
	help
	  This is a driver for the 'security ID' available on various Allwinner
	  devices.

	  This driver can also be built as a module. If so, the module
	  will be called sunxi_sid.

endif
```

## drivers/misc/eeprom/Kconfig
```kconfig
menu "EEPROM support"

config EEPROM_LEGACY
	tristate "Old I2C EEPROM reader"
	depends on I2C && SYSFS
	help
	  If you say yes here you get read-only access to the EEPROM data
	  available on modern memory DIMMs and Sony Vaio laptops via I2C. Such
	  EEPROMs could theoretically be available on other devices as well.

	  This driver can also be built as a module.  If so, the module
	  will be called eeprom.

config EEPROM_MAX6875
	tristate "Maxim MAX6874/5 power supply supervisor"
	depends on I2C
	help
	  If you say yes here you get read-only support for the user EEPROM of
	  the Maxim MAX6874/5 EEPROM-programmable, quad power-supply
	  sequencer/supervisor.

	  All other features of this chip should be accessed via i2c-dev.

	  This driver can also be built as a module.  If so, the module
	  will be called max6875.


config EEPROM_93CX6
	tristate "EEPROM 93CX6 support"
	help
	  This is a driver for the EEPROM chipsets 93c46 and 93c66.
	  The driver supports both read as well as write commands.

	  If unsure, say N.

config EEPROM_93XX46
	tristate "Microwire EEPROM 93XX46 support"
	depends on SPI && SYSFS
	help
	  Driver for the microwire EEPROM chipsets 93xx46x. The driver
	  supports both read and write commands and also the command to
	  erase the whole EEPROM.

	  This driver can also be built as a module.  If so, the module
	  will be called eeprom_93xx46.

	  If unsure, say N.

config EEPROM_DIGSY_MTC_CFG
	bool "DigsyMTC display configuration EEPROMs device"
	depends on GPIO_MPC5200 && SPI_GPIO
	help
	  This option enables access to display configuration EEPROMs
	  on digsy_mtc board. You have to additionally select Microwire
	  EEPROM 93XX46 driver. sysfs entries will be created for that
	  EEPROM allowing to read/write the configuration data or to
	  erase the whole EEPROM.

	  If unsure, say N.

endmenu
```
